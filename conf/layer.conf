## conf/layer.conf
```bitbake
# We have a conf and classes directory, add to BBPATH
BBPATH .= ":${LAYERDIR}"

# We have recipes-* directories, add to BBFILES
BBFILES += "${LAYERDIR}/recipes-*/*/*.bb \
            ${LAYERDIR}/recipes-*/*/*.bbappend"

BBFILE_COLLECTIONS += "fabmo"
BBFILE_PATTERN_fabmo = "^${LAYERDIR}/"
BBFILE_PRIORITY_fabmo = "10"
LAYERVERSION_fabmo = "3"

PREFERRED_VERSION_nodejs = "0.10.44"
PREFERRED_VERSION_nodejs-native = "0.10.44"
PREFERRED_PROVIDER_node = "nodejs"
PREFERRED_PROVIDER_node-native = "nodejs-native"

BBMASK = "meta-fabmo/recipes-connectivity/connman*"

IMAGE_INSTALL_append = " fabmo-updater fabmo-engine aufs-util overlay termsize"

PREFERRED_VERSION_linux-yocto ?= "3.18%"
```
